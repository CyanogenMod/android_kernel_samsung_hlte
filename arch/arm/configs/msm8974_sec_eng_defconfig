## arch/arm/configs/msm8974_sec_eng_defconfig
```kconfig
CONFIG_MSM_L2_ERP_PRINT_ACCESS_ERRORS=y
# CONFIG_MSM_L2_ERP_PORT_PANIC is not set
# CONFIG_MSM_L2_ERP_1BIT_PANIC is not set
CONFIG_MSM_CACHE_DUMP=y
CONFIG_MSM_CACHE_DUMP_ON_PANIC=y
CONFIG_MSM_IOMMU_PMON=y
CONFIG_LOCKUP_DETECTOR=y
CONFIG_UID_STAT=y
# CONFIG_DETECT_HUNG_TASK is not set
CONFIG_SCHEDSTATS=y
CONFIG_DEBUG_KMEMLEAK=y
CONFIG_DEBUG_KMEMLEAK_DEFAULT_OFF=y
CONFIG_DEBUG_SPINLOCK=y
CONFIG_DEBUG_MUTEXES=y
CONFIG_DEBUG_ATOMIC_SLEEP=y
CONFIG_DEBUG_STACK_USAGE=y
CONFIG_DEBUG_LIST=y
CONFIG_FAULT_INJECTION=y
CONFIG_FAIL_PAGE_ALLOC=y
CONFIG_FAULT_INJECTION_DEBUG_FS=y
CONFIG_FAULT_INJECTION_STACKTRACE_FILTER=y
CONFIG_PANIC_ON_DATA_CORRUPTION=y
# CONFIG_DEBUG_PAGEALLOC is not set
CONFIG_CPU_FREQ_SWITCH_PROFILER=y
CONFIG_DEBUG_LL=y
CONFIG_EARLY_PRINTK=y
CONFIG_ENABLE_DEFAULT_TRACERS=y
CONFIG_SEC_FILE_LEAK_DEBUG=y
CONFIG_CORESIGHT_ETM_DEFAULT_ENABLE=y
CONFIG_SLUB_DEBUG=y
CONFIG_ES325_UART_WORKAROUND_ENG_ONLY=y
CONFIG_SEC_DEBUG_LMK_MEMINFO=y
CONFIG_SEC_DEBUG_ZERO_FD_CLOSE=y
CONFIG_SEC_DEBUG_SPINLOCK_PANIC=y
CONFIG_SEC_DEBUG_DOUBLE_FREE=y
CONFIG_SYSFS=y
CONFIG_BLOCK=y
CONFIG_TRACING_SUPPORT=y
CONFIG_FTRACE=y
CONFIG_BLK_DEV_IO_TRACE=y
CONFIG_SEC_DEBUG_LIST_PANIC=y
CONFIG_SCHEDSTATS=y
CONFIG_CORESIGHT_FUSE=y
CONFIG_CORESIGHT_HWEVENT=y
CONFIG_CORESIGHT=y
CONFIG_CORESIGHT_TMC=y
CONFIG_CORESIGHT_TPIU=y
CONFIG_CORESIGHT_FUNNEL=y
CONFIG_CORESIGHT_REPLICATOR=y
CONFIG_CORESIGHT_STM=y
CONFIG_CORESIGHT_ETM=y
CONFIG_CORESIGHT_ETM_PCSAVE_DEFAULT_ENABLE=y
CONFIG_CORESIGHT_EVENT=y

# CONFIG_SEC_RESTRICT_ROOTING is not set
# CONFIG_SEC_RESTRICT_SETUID is not set
# CONFIG_SEC_RESTRICT_FORK is not set
# CONFIG_SEC_RESTRICT_ROOTING_LOG is not set
CONFIG_SAMSUNG_BATTERY_ENG_TEST=y
```

## arch/arm/configs/msm8974_sec_fac_js01ltedcm_defconfig
```kconfig
CONFIG_SEC_LOCALE_JPN=y
CONFIG_SEC_OPERATOR_DCM=y
CONFIG_MACH_JS01LTEDCM=y
CONFIG_LCD_CLASS_DEVICE=y
CONFIG_BACKLIGHT_LCD_SUPPORT=y
CONFIG_BACKLIGHT_CLASS_DEVICE=y
CONFIG_MDNIE_LITE_TUNING=y
CONFIG_FB_MSM_MIPI_SAMSUNG_OCTA_VIDEO_FULL_HD_PT_PANEL=y
CONFIG_LEDS_QPNP=y
#
# ODE and DIR Encryption
#
CONFIG_CRYPTO=y
CONFIG_CRYPTO_SHA1=y
CONFIG_CRYPTO_SHA256=y
CONFIG_CRYPTO_AES=y
CONFIG_CRYPTO_CBC=y
CONFIG_ECRYPT_FS=y
CONFIG_WTL_ENCRYPTION_FILTER=y
CONFIG_KEYS=y
CONFIG_KEYS_DEBUG_PROC_KEYS=y

# INPUT Devices
CONFIG_TOUCHSCREEN_SYNAPTICS_I2C_RMI=y
CONFIG_KEYBOARD_CYPRESS_TOUCHKEY=y
CONFIG_SEC_TSP_FACTORY=y
# CONFIG_INPUT_WACOM=y

# BT
CONFIG_BT_L2CAP=y
CONFIG_BT_SCO=y
CONFIG_BT_HIDP=y
CONFIG_HID_SUPPORT=y
CONFIG_UHID=y
CONFIG_HID=y
CONFIG_HIDRAW=y
CONFIG_BT_HCISMD=n
CONFIG_BT_HCIUART_H4=y
CONFIG_BT_HCIUART_IBS=n
CONFIG_BT_HCIUART=y
CONFIG_BT_BCM4339=y
CONFIG_MSM_BT_POWER=n
CONFIG_SERIAL_MSM_HS=y
CONFIG_SERIAL_MSM_HSL=y

#
# MAX77803 Charger
#

# CONFIG_QPNP_CHARGER is not set
# CONFIG_QPNP_BMS is not set
CONFIG_BATTERY_SAMSUNG=y
CONFIG_SAMSUNG_LPM_MODE=y
CONFIG_FUELGAUGE_MAX17048=y
CONFIG_CHARGER_MAX77803=y

CONFIG_SENSORS_HALL=y
CONFIG_GLOVE_TOUCH=y
CONFIG_MMC_MSM_SDC3_SUPPORT=y

# CONFIG_SENSORS_FINGERPRINT is not set

#
# MAX77803 IC
#
CONFIG_MFD_MAX77803=y
CONFIG_REGULATOR_MAX77803=y
CONFIG_MOTOR_DRV_MAX77803=y
CONFIG_VIBETONZ=y
CONFIG_LEDS_MAX77803=y
#
# Actuator
#
CONFIG_I2C_ACTUATOR=y
#
# Sensor hub
#
CONFIG_SENSORS_SSP_STM=y
CONFIG_SENSORS_SSP_MAX88921=y

# Earjack
CONFIG_SAMSUNG_JACK=y
CONFIG_INPUT_GPIO=y

#
# Remove Qualcomm Wifi features
#
CONFIG_MSM_PIL_PRONTO=n
CONFIG_WCNSS_CORE=n
CONFIG_WCNSS_CORE_PRONTO=n
#
# Wifi features (Broadcomm)
#
CONFIG_NET_CORE=y
CONFIG_WIRELESS=y
CONFIG_WIRELESS_EXT_SYSFS=y
CONFIG_WEXT_CORE=y
CONFIG_WEXT_PROC=y
CONFIG_CFG80211=y
CONFIG_CFG80211_DEFAULT_PS=y
CONFIG_CFG80211_ALLOW_RECONNECT=y
CONFIG_WLAN=y
CONFIG_WIFI_CONTROL_FUNC=y
CONFIG_BCM4339=y
CONFIG_BCMDHD_FW_PATH="/system/etc/wifi/bcmdhd_sta.bin"
CONFIG_BCMDHD_NVRAM_PATH="/system/etc/wifi/nvram_net.txt"
CONFIG_BROADCOM_WIFI_RESERVED_MEM=y
CONFIG_WLAN_REGION_CODE=100
CONFIG_MMC_MSM_SDC2_SUPPORT=y
CONFIG_H_EUR_WIFI=y
#
# DWC3 usb 3.0 driver
#
CONFIG_USB_XHCI_HCD=y
CONFIG_USB_DWC3=y
CONFIG_USB_DWC3_MSM=y
# DHA Solution
CONFIG_SEC_DHA_SOL_MAL=y
# Audience
CONFIG_SND_SOC_ES325=y
CONFIG_SND_SOC_ES325_SLIM=y
CONFIG_FW_LOADER=y
CONFIG_FIRMWARE_IN_KERNEL=y
CONFIG_EXTRA_FIRMWARE="audience-es325-fw-js01.bin"
CONFIG_EXTRA_FIRMWARE_DIR="firmware"

#FeliCa
CONFIG_FELICA=y
CONFIG_NFC_FELICA=y
CONFIG_SEC_LOCALE_JPN=y
#ISDBTMM
CONFIG_ISDBTMM=y
CONFIG_TMM_ANT_DET=y
CONFIG_TMM_CHG_CTRL=y
#CPRM
CONFIG_MMC_CPRM=y
```

## arch/arm/configs/msm8974_sec_flteeur_defconfig
```kconfig
CONFIG_SEC_LOCALE_EUR=y
CONFIG_SEC_OPERATOR_OPEN=y
CONFIG_MACH_FLTEEUR=y
CONFIG_LCD_CLASS_DEVICE=y
CONFIG_BACKLIGHT_LCD_SUPPORT=y
CONFIG_BACKLIGHT_CLASS_DEVICE=y
CONFIG_MDNIE_LITE_TUNING=y
CONFIG_FB_MSM_MIPI_SAMSUNG_YOUM_CMD_FULL_HD_PT_PANEL=y
CONFIG_LEDS_QPNP=y
#
# ODE and DIR Encryption
#
CONFIG_CRYPTO=y
CONFIG_CRYPTO_SHA1=y
CONFIG_CRYPTO_SHA256=y
CONFIG_CRYPTO_AES=y
CONFIG_CRYPTO_CBC=y
CONFIG_ECRYPT_FS=y
CONFIG_WTL_ENCRYPTION_FILTER=y
CONFIG_KEYS=y
CONFIG_KEYS_DEBUG_PROC_KEYS=y

# INPUT Devices
CONFIG_TOUCHSCREEN_SYNAPTICS_I2C_RMI_H=y
# CONFIG_KEYBOARD_CYPRESS_TOUCHKEY is not set
# CONFIG_INPUT_WACOM is not set

# BT
CONFIG_BT_L2CAP=y
CONFIG_BT_SCO=y
CONFIG_BT_HIDP=y
CONFIG_HID_SUPPORT=y
CONFIG_UHID=y
CONFIG_HID=y
CONFIG_HIDRAW=y
CONFIG_BT_HCISMD=n
CONFIG_BT_HCIUART_H4=y
CONFIG_BT_HCIUART_IBS=n
CONFIG_BT_HCIUART=y
CONFIG_BT_BCM4339=y
CONFIG_MSM_BT_POWER=n
CONFIG_SERIAL_MSM_HS=y
CONFIG_SERIAL_MSM_HSL=y

#
# MAX77803 Charger
#

# CONFIG_QPNP_CHARGER is not set
# CONFIG_QPNP_BMS is not set
CONFIG_BATTERY_SAMSUNG=y
CONFIG_SAMSUNG_LPM_MODE=y
CONFIG_FUELGAUGE_MAX17048=y
CONFIG_CHARGER_MAX77803=y

CONFIG_SENSORS_HALL=y
CONFIG_GLOVE_TOUCH=y
CONFIG_MMC_MSM_SDC3_SUPPORT=y

# CONFIG_SENSORS_FINGERPRINT is not set

#
# MAX77803 IC
#
CONFIG_MFD_MAX77803=y
CONFIG_REGULATOR_MAX77803=y
CONFIG_MOTOR_DRV_MAX77803=y
CONFIG_VIBETONZ=y
#CONFIG_MOTOR_DRV_TSP5000 is not set
CONFIG_LEDS_MAX77803=y
#
# Actuator
#
CONFIG_I2C_ACTUATOR=y
#
# Sensor hub
#
CONFIG_SENSORS_SSP_STM=y
CONFIG_SENSORS_SSP_MAX88921=y
CONFIG_SENSORS_SSP_BOUNCE_FIRMWARE=y
CONFIG_NFC_PN547=y

# Earjack
CONFIG_SAMSUNG_JACK=y
CONFIG_INPUT_GPIO=y

#
# Remove Qualcomm Wifi features
#
CONFIG_MSM_PIL_PRONTO=n
CONFIG_WCNSS_CORE=n
CONFIG_WCNSS_CORE_PRONTO=n
#
# Wifi features (Broadcomm)
#
CONFIG_NET_CORE=y
CONFIG_WIRELESS=y
CONFIG_WIRELESS_EXT_SYSFS=y
CONFIG_WEXT_CORE=y
CONFIG_WEXT_PROC=y
CONFIG_CFG80211=y
CONFIG_CFG80211_DEFAULT_PS=y
CONFIG_CFG80211_ALLOW_RECONNECT=y
CONFIG_WLAN=y
CONFIG_WIFI_CONTROL_FUNC=y
CONFIG_BCM4339=y
CONFIG_BCMDHD_FW_PATH="/system/etc/wifi/bcmdhd_sta.bin"
CONFIG_BCMDHD_NVRAM_PATH="/system/etc/wifi/nvram_net.txt"
CONFIG_BROADCOM_WIFI_RESERVED_MEM=y
CONFIG_WLAN_REGION_CODE=100
CONFIG_MMC_MSM_SDC2_SUPPORT=y

#
# DWC3 usb 3.0 driver
#
CONFIG_USB_XHCI_HCD=y
CONFIG_USB_DWC3=y
CONFIG_USB_DWC3_MSM=y
# DHA Solution
CONFIG_SEC_DHA_SOL_MAL=y
# Audience
CONFIG_SND_SOC_ES325=y
CONFIG_SND_SOC_ES325_SLIM=y
CONFIG_FW_LOADER=y
CONFIG_FIRMWARE_IN_KERNEL=y
CONFIG_EXTRA_FIRMWARE="audience-es325-fw-F-eur.bin"
CONFIG_EXTRA_FIRMWARE_DIR="firmware"
```

## arch/arm/configs/msm8974_sec_h3g_chncmcc_defconfig
```kconfig
CONFIG_SEC_LOCALE_EUR=y
CONFIG_SEC_OPERATOR_OPEN=y
CONFIG_MACH_HLTEEUR=y
CONFIG_MACH_H3G_CHN_CMCC=y
CONFIG_LCD_CLASS_DEVICE=y
CONFIG_BACKLIGHT_LCD_SUPPORT=y
CONFIG_BACKLIGHT_CLASS_DEVICE=y
CONFIG_MDNIE_LITE_TUNING=y
CONFIG_FB_MSM_MIPI_SAMSUNG_OCTA_CMD_FULL_HD_PT_PANEL=y
CONFIG_LEDS_QPNP=y
#
# ODE and DIR Encryption
#
CONFIG_CRYPTO=y
CONFIG_CRYPTO_SHA1=y
CONFIG_CRYPTO_SHA256=y
CONFIG_CRYPTO_AES=y
CONFIG_CRYPTO_CBC=y
CONFIG_ECRYPT_FS=y
CONFIG_WTL_ENCRYPTION_FILTER=y
CONFIG_KEYS=y
CONFIG_KEYS_DEBUG_PROC_KEYS=y

# INPUT Devices
CONFIG_TOUCHSCREEN_SYNAPTICS_I2C_RMI_H=y
CONFIG_KEYBOARD_CYPRESS_TOUCHKEY=y
CONFIG_INPUT_WACOM=y

# BT
CONFIG_BT_BCM4339=y

#
# MAX77803 Charger
#

# CONFIG_QPNP_CHARGER is not set
# CONFIG_QPNP_BMS is not set
CONFIG_BATTERY_SAMSUNG=y
CONFIG_SAMSUNG_LPM_MODE=y
CONFIG_FUELGAUGE_MAX17048=y
CONFIG_CHARGER_MAX77803=y

CONFIG_SENSORS_HALL=y
CONFIG_GLOVE_TOUCH=y
CONFIG_MMC_MSM_SDC3_SUPPORT=y

#CONFIG_SENSORS_FINGERPRINT is not set

#
# MAX77803 IC
#
CONFIG_MFD_MAX77803=y
CONFIG_REGULATOR_MAX77803=y
CONFIG_MOTOR_DRV_MAX77803=y
CONFIG_VIBETONZ=y
CONFIG_LEDS_MAX77803=y
#
# Actuator
#
CONFIG_I2C_ACTUATOR=y
#
# Sensor hub
#
CONFIG_SENSORS_SSP_STM=y
CONFIG_SENSORS_SSP_MAX88921=y
CONFIG_BCM2079X_NFC_I2C=y

# Earjack
CONFIG_SAMSUNG_JACK=y
CONFIG_INPUT_GPIO=y

#
# Remove Qualcomm Wifi features
#
CONFIG_MSM_PIL_PRONTO=n
CONFIG_WCNSS_CORE=n
CONFIG_WCNSS_CORE_PRONTO=n
#
# Wifi features (Broadcomm)
#
CONFIG_NET_CORE=y
CONFIG_WIRELESS=y
CONFIG_WIRELESS_EXT_SYSFS=y
CONFIG_WEXT_CORE=y
CONFIG_WEXT_PROC=y
CONFIG_CFG80211=y
CONFIG_CFG80211_DEFAULT_PS=y
CONFIG_CFG80211_ALLOW_RECONNECT=y
CONFIG_WLAN=y
CONFIG_WIFI_CONTROL_FUNC=y
CONFIG_BCM4339=y
CONFIG_BCMDHD_FW_PATH="/system/etc/wifi/bcmdhd_sta.bin"
CONFIG_BCMDHD_NVRAM_PATH="/system/etc/wifi/nvram_net.txt"
CONFIG_BROADCOM_WIFI_RESERVED_MEM=y
CONFIG_WLAN_REGION_CODE=300
CONFIG_TARGET_LOCALE_CHN=y
CONFIG_MMC_MSM_SDC2_SUPPORT=y
CONFIG_H_EUR_WIFI=y
#
# DWC3 usb 3.0 driver
#
CONFIG_USB_XHCI_HCD=y
CONFIG_USB_DWC3=y
CONFIG_USB_DWC3_MSM=y
# DHA Solution
CONFIG_SEC_DHA_SOL_MAL=y
# Audience
CONFIG_SND_SOC_ES325=y
CONFIG_SND_SOC_ES325_SLIM=y
CONFIG_FW_LOADER=y
CONFIG_FIRMWARE_IN_KERNEL=y
CONFIG_EXTRA_FIRMWARE="audience-es325-fw-cmcc.bin"
CONFIG_EXTRA_FIRMWARE_DIR="firmware"

# SAPA
CONFIG_RTC_AUTO_PWRON=y
CONFIG_RTC_AUTO_PWRON_PARAM=y

#one wire
CONFIG_W1=y
CONFIG_W1_MASTER_GPIO_MSM=y
CONFIG_W1_SLAVE_DS28EL15=y

# Disable moudle build for Google CTS
# CONFIG_MODULES is not set
# CONFIG_MODULE_UNLOAD is not set
# CONFIG_MODULE_FORCE_UNLOAD is not set
```

## arch/arm/configs/msm8974_sec_hltektt_defconfig
```kconfig
CONFIG_SEC_LOCALE_KOR=y
CONFIG_SEC_LOCALE_KOR_H=y
CONFIG_SEC_OPERATOR_KTT=y
CONFIG_MACH_HLTEKTT=y
CONFIG_LCD_CLASS_DEVICE=y
CONFIG_BACKLIGHT_LCD_SUPPORT=y
CONFIG_BACKLIGHT_CLASS_DEVICE=y
CONFIG_MDNIE_LITE_TUNING=y
CONFIG_FB_MSM_MIPI_SAMSUNG_OCTA_CMD_FULL_HD_PT_PANEL=y
CONFIG_LEDS_QPNP=y
#
# ODE and DIR Encryption
#
CONFIG_CRYPTO=y
CONFIG_CRYPTO_SHA1=y
CONFIG_CRYPTO_SHA256=y
CONFIG_CRYPTO_AES=y
CONFIG_CRYPTO_CBC=y
CONFIG_ECRYPT_FS=y
CONFIG_WTL_ENCRYPTION_FILTER=y
CONFIG_KEYS=y
CONFIG_KEYS_DEBUG_PROC_KEYS=y

#
# Remove Qualcomm Wifi features
#
CONFIG_MSM_PIL_PRONTO=n
CONFIG_WCNSS_CORE=n
CONFIG_WCNSS_CORE_PRONTO=n
#
# Wifi features (Broadcomm)
#
CONFIG_NET_CORE=y
CONFIG_WIRELESS=y
CONFIG_WIRELESS_EXT_SYSFS=y
CONFIG_WEXT_CORE=y
CONFIG_WEXT_PROC=y
CONFIG_CFG80211=y
CONFIG_CFG80211_DEFAULT_PS=y
CONFIG_CFG80211_ALLOW_RECONNECT=y
CONFIG_WLAN=y
CONFIG_WIFI_CONTROL_FUNC=y
CONFIG_BCM4339=y
CONFIG_BCMDHD_FW_PATH="/system/etc/wifi/bcmdhd_sta.bin"
CONFIG_BCMDHD_NVRAM_PATH="/system/etc/wifi/nvram_net.txt"
CONFIG_BROADCOM_WIFI_RESERVED_MEM=y
CONFIG_WLAN_REGION_CODE=202
CONFIG_MMC_MSM_SDC2_SUPPORT=y

#
# TDMB
#
CONFIG_TDMB=y
CONFIG_TDMB_VENDOR_RAONTECH=y
CONFIG_TDMB_MTV319=y
CONFIG_TDMB_SPI=y
CONFIG_TDMB_ANT_DET=y

# INPUT Devices
CONFIG_TOUCHSCREEN_SYNAPTICS_I2C_RMI_H=y
CONFIG_KEYBOARD_CYPRESS_TOUCHKEY=y
CONFIG_INPUT_WACOM=y

# BT
CONFIG_BT_BCM4339=y

#
# MAX77803 Charger
#

# CONFIG_QPNP_CHARGER is not set
# CONFIG_QPNP_BMS is not set
CONFIG_BATTERY_SAMSUNG=y
CONFIG_SAMSUNG_LPM_MODE=y
CONFIG_FUELGAUGE_MAX17048=y
CONFIG_CHARGER_MAX77803=y

CONFIG_SENSORS_HALL=y
CONFIG_GLOVE_TOUCH=y
CONFIG_MMC_MSM_SDC3_SUPPORT=y

# CONFIG_SENSORS_FINGERPRINT is not set

#
# MAX77803 IC
#
CONFIG_MFD_MAX77803=y
CONFIG_REGULATOR_MAX77803=y
CONFIG_MOTOR_DRV_MAX77803=y
CONFIG_VIBETONZ=y
CONFIG_LEDS_MAX77803=y
#
# Actuator
#
CONFIG_I2C_ACTUATOR=y
#
# Sensor hub
#
CONFIG_SENSORS_SSP_STM=y
CONFIG_SENSORS_SSP_MAX88921=y
CONFIG_BCM2079X_NFC_I2C=y

CONFIG_SAMSUNG_JACK=y
CONFIG_INPUT_GPIO=y
#
# DWC3 usb 3.0 driver
#
CONFIG_USB_XHCI_HCD=y
CONFIG_USB_DWC3=y
CONFIG_USB_DWC3_MSM=y

# DHA Solution
CONFIG_SEC_DHA_SOL_MAL=y
# Ringback tone gain devide
CONFIG_SEC_DEVIDE_RINGTONE_GAIN=y
# Audience
CONFIG_SND_SOC_ES325=y
CONFIG_SND_SOC_ES325_SLIM=y
CONFIG_FW_LOADER=y
CONFIG_FIRMWARE_IN_KERNEL=y
CONFIG_EXTRA_FIRMWARE="audience-es325-fw-kor-hlte.bin"
CONFIG_EXTRA_FIRMWARE_DIR="firmware"
CONFIG_ES325_UART_WORKAROUND=y

#B10
CONFIG_USER_RESET_DEBUG=y
CONFIG_SEC_LOG_LAST_KMSG=y

#one wire
CONFIG_W1=y
CONFIG_W1_MASTER_GPIO_MSM=y
CONFIG_W1_SLAVE_DS28EL15=y
```

## arch/arm/configs/msm8974_sec_jactiveskt_defconfig
```kconfig
CONFIG_SEC_LOCALE_KOR=y
CONFIG_SEC_OPERATOR_SKT=y
CONFIG_MACH_JACTIVESKT=y
CONFIG_LCD_CLASS_DEVICE=y
CONFIG_BACKLIGHT_LCD_SUPPORT=y
CONFIG_BACKLIGHT_CLASS_DEVICE=y
CONFIG_FB_MSM_MIPI_JDI_TFT_VIDEO_FULL_HD_PT_PANEL=y
#CONFIG_MDNIE_LITE_TUNING is not set
CONFIG_LEDS_AN30259A=y
#
# ODE and DIR Encryption
#
CONFIG_CRYPTO=y
CONFIG_CRYPTO_SHA1=y
CONFIG_CRYPTO_SHA256=y
CONFIG_CRYPTO_AES=y
CONFIG_CRYPTO_CBC=y
CONFIG_ECRYPT_FS=y
CONFIG_WTL_ENCRYPTION_FILTER=y
CONFIG_KEYS=y
CONFIG_KEYS_DEBUG_PROC_KEYS=y
CONFIG_TDMB=y
CONFIG_TDMB_VENDOR_FCI=y
CONFIG_TDMB_FC8050=y
CONFIG_TDMB_SPI=y
CONFIG_TDMB_ANT_DET=y

CONFIG_TCP_CONG_ADVANCED=y
CONFIG_TCP_CONG_BIC=y
CONFIG_DEFAULT_BIC=y
CONFIG_DEFAULT_TCP_CONG="bic"

# TSP and TOUCHKEY
CONFIG_TOUCHSCREEN_SYNAPTICS_I2C_RMI=y
CONFIG_TOUCHSCREEN_SYNAPTICS_PREVENT_HSYNC_LEAKAGE=y
#CONFIG_KEYBOARD_CYPRESS_TOUCH is not set

# BT
CONFIG_BT_BCM4335=y


#
# Remove Qualcomm Wifi features
#
CONFIG_MSM_PIL_PRONTO=n
CONFIG_WCNSS_CORE=n
CONFIG_WCNSS_CORE_PRONTO=n
#
# Wifi features (Broadcomm)
#
CONFIG_NET_CORE=y
CONFIG_WIRELESS=y
CONFIG_WIRELESS_EXT_SYSFS=y
CONFIG_WEXT_CORE=y
CONFIG_WEXT_PROC=y
CONFIG_CFG80211=y
CONFIG_CFG80211_DEFAULT_PS=y
CONFIG_CFG80211_ALLOW_RECONNECT=y
CONFIG_WLAN=y
CONFIG_WIFI_CONTROL_FUNC=y
CONFIG_BCM4335=m
CONFIG_BROADCOM_WIFI_RESERVED_MEM=y
CONFIG_WLAN_REGION_CODE=201
CONFIG_MMC_MSM_SDC2_SUPPORT=y
#
#SKT IWLAN
#
CONFIG_XFRM=y
CONFIG_XFRM_USER=y
CONFIG_NET_KEY=y
CONFIG_INET_ESP=y
CONFIG_INET_IPCOMP=y
CONFIG_INET_XFRM_MODE_TRANSPORT=y
CONFIG_INET_XFRM_MODE_TUNNEL=y
CONFIG_IP_ADVANCED_ROUTER=y
CONFIG_IP_MULTIPLE_TABLES=y
CONFIG_CRYPTO=y
CONFIG_CRYPTO_HMAC=y
CONFIG_CRYPTO_XCBC=y
CONFIG_CRYPTO_NULL=y
CONFIG_CRYPTO_MD5=y
CONFIG_CRYPTO_SHA1=y
CONFIG_CRYPTO_DES=y
CONFIG_CRYPTO_AES=y
CONFIG_CRYPTO_DEFLATE=y
#
# MAX77803 Charger
#
CONFIG_BATTERY_SAMSUNG=y
CONFIG_SAMSUNG_LPM_MODE=y
CONFIG_FUELGAUGE_MAX17048=y
CONFIG_CHARGER_MAX77803=y
CONFIG_SENSORS_HALL=y
CONFIG_GLOVE_TOUCH=y
#
# MAX77803 IC
#
CONFIG_MFD_MAX77803=y
CONFIG_REGULATOR_MAX77803=y
CONFIG_MOTOR_DRV_MAX77803=y
CONFIG_VIBETONZ=y
CONFIG_TOUCHSENSE_VIBRATOR=y
CONFIG_LEDS_MAX77803=y
CONFIG_USB_PRINTER=y
CONFIG_USB_STORAGE_DETECT=y
CONFIG_USB_HOST_NOTIFY=y
CONFIG_USB=y
#
# DWC3 usb 3.0 driver
#
CONFIG_USB_XHCI_HCD=y
CONFIG_USB_DWC3=y
CONFIG_USB_DWC3_MSM=y
#
# Sensor hub
#
CONFIG_SENSORS_SSP_ATMEL=y
CONFIG_SENSORS_SSP_CM3320=y
CONFIG_SENSORS_SSP_MAX88920=y
CONFIG_BCM2079X_NFC_I2C=y
#
# Actuator
#
CONFIG_I2C_ACTUATOR=y
# DHA Solution
CONFIG_SEC_DHA_SOL_MAL=y
# Ringback tone gain devide
CONFIG_SEC_DEVIDE_RINGTONE_GAIN=y
# Audience
CONFIG_SND_SOC_ES325=y
CONFIG_SND_SOC_ES325_SLIM=y
CONFIG_FW_LOADER=y
CONFIG_FIRMWARE_IN_KERNEL=y
CONFIG_EXTRA_FIRMWARE="audience-es325-fw-kor.bin"
CONFIG_EXTRA_FIRMWARE_DIR="firmware"
#
# NANDSWAP
#
CONFIG_FRONTSWAP=y
CONFIG_ZSMALLOC_NEW=y
CONFIG_PGTABLE_MAPPING=y
CONFIG_ZSWAP=y
CONFIG_DIRECT_RECLAIM_FILE_PAGES_ONLY=y
CONFIG_DIRECT_RECLAIM_ALLOW_COMPACTION=y
CONFIG_TIGHT_PGDAT_BALANCE=y
CONFIG_COMPACTION=y
CONFIG_VNSWAP=y

CONFIG_SEC_DEBUG_LMK_MEMINFO_VERBOSE=y
CONFIG_SEC_OOM_KILLER=y
CONFIG_SEC_DEBUG_LIST_PANIC=y
CONFIG_SEC_LOG_LAST_KMSG=y
CONFIG_USER_RESET_DEBUG=y
```
