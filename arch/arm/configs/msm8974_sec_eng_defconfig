## arch/arm/configs/msm8974_sec_ks01ktt_defconfig
```kconfig
CONFIG_SEC_LOCALE_KOR=y
CONFIG_SEC_OPERATOR_KTT=y
CONFIG_MACH_KS01KTT=y
CONFIG_LCD_CLASS_DEVICE=y
CONFIG_BACKLIGHT_LCD_SUPPORT=y
CONFIG_BACKLIGHT_CLASS_DEVICE=y
#
# ODE and DIR Encryption
#
CONFIG_CRYPTO=y
CONFIG_CRYPTO_SHA1=y
CONFIG_CRYPTO_SHA256=y
CONFIG_CRYPTO_AES=y
CONFIG_CRYPTO_CBC=y
CONFIG_ECRYPT_FS=y
CONFIG_WTL_ENCRYPTION_FILTER=y
CONFIG_KEYS=y
CONFIG_KEYS_DEBUG_PROC_KEYS=y
CONFIG_TDMB=y
CONFIG_TDMB_VENDOR_FCI=y
CONFIG_TDMB_FC8050=y
CONFIG_TDMB_SPI=y
CONFIG_TDMB_ANT_DET=y
CONFIG_TCP_CONG_ADVANCED=y
CONFIG_TCP_CONG_BIC=y
CONFIG_DEFAULT_BIC=y
CONFIG_DEFAULT_TCP_CONG="bic"

# TSP and TOUCHKEY
CONFIG_TOUCHSCREEN_SYNAPTICS_I2C_RMI=y
CONFIG_KEYBOARD_CYPRESS_TOUCH=y

#
# Charging/Fuelgauge
#
CONFIG_QPNP_CHARGER=y
CONFIG_QPNP_BMS=y
CONFIG_SENSORS_HALL=y
CONFIG_GLOVE_TOUCH=y
CONFIG_USB_SWITCH_TSU6721=y
#
# Sensor hub
#
CONFIG_SENSORS_SSP_ATMEL=y
```

## arch/arm/configs/msm8974_sec_lt03eur_defconfig
```kconfig
CONFIG_SEC_LOCALE_EUR=y
CONFIG_SEC_OPERATOR_OPEN=y
CONFIG_MACH_LT03EUR=y
CONFIG_LCD_CLASS_DEVICE=y
CONFIG_BACKLIGHT_LCD_SUPPORT=y
CONFIG_BACKLIGHT_CLASS_DEVICE=y
CONFIG_FB_MSM_EDP_SAMSUNG=y
#
# ODE and DIR Encryption
#
CONFIG_CRYPTO=y
CONFIG_CRYPTO_SHA1=y
CONFIG_CRYPTO_SHA256=y
CONFIG_CRYPTO_AES=y
CONFIG_CRYPTO_CBC=y
CONFIG_ECRYPT_FS=y
CONFIG_WTL_ENCRYPTION_FILTER=y
CONFIG_KEYS=y
CONFIG_KEYS_DEBUG_PROC_KEYS=y

# BT
CONFIG_BT_BCM4339=y

#
# Battery driver(Charger, Fuelgauge)
#

# CONFIG_QPNP_CHARGER is not set
# CONFIG_QPNP_BMS is not set
CONFIG_BATTERY_SAMSUNG=y
CONFIG_SAMSUNG_LPM_MODE=y
CONFIG_FUELGAUGE_MAX17050=y
CONFIG_FUELGAUGE_MAX17050_COULOMB_COUNTING=y
CONFIG_CHARGER_BQ24260=y

CONFIG_SENSORS_HALL=y
CONFIG_GLOVE_TOUCH=y
CONFIG_MMC_MSM_SDC3_SUPPORT=y

#
# Finger print sensor
#
CONFIG_SENSORS_FINGERPRINT=y
CONFIG_SENSORS_VFS61XX=y
#
# Motor
CONFIG_VIBETONZ=y
CONFIG_MOTOR_DRV_DRV2603=y
# Actuator
#
CONFIG_I2C_ACTUATOR=y

CONFIG_INPUT_WACOM=y

# Earjack
CONFIG_SAMSUNG_JACK=y
CONFIG_INPUT_GPIO=y

#
# Remove Qualcomm Wifi features
#
CONFIG_MSM_PIL_PRONTO=n
CONFIG_WCNSS_CORE=n
CONFIG_WCNSS_CORE_PRONTO=n
#
# Wifi features (Broadcomm)
#
CONFIG_NET_CORE=y
CONFIG_WIRELESS=y
CONFIG_WIRELESS_EXT_SYSFS=y
CONFIG_WEXT_CORE=y
CONFIG_WEXT_PROC=y
CONFIG_CFG80211=y
CONFIG_CFG80211_DEFAULT_PS=y
CONFIG_CFG80211_ALLOW_RECONNECT=y
CONFIG_WLAN=y
CONFIG_WIFI_CONTROL_FUNC=y
CONFIG_BCM4339=y
CONFIG_BCMDHD_FW_PATH="/system/etc/wifi/bcmdhd_sta.bin"
CONFIG_BCMDHD_NVRAM_PATH="/system/etc/wifi/nvram_net.txt"
CONFIG_BROADCOM_WIFI_RESERVED_MEM=y
CONFIG_WLAN_REGION_CODE=100
CONFIG_MMC_MSM_SDC2_SUPPORT=y
CONFIG_H_EUR_WIFI=y
#
# DWC3 usb 3.0 driver
#
CONFIG_USB_XHCI_HCD=y
CONFIG_USB_DWC3=y
CONFIG_USB_DWC3_MSM=y
# TouchScreen / TouchKey
CONFIG_TOUCHSCREEN_ATMEL_MXT1664S=y
CONFIG_USB_SWITCH_FSA9485=y

# Sensors
CONFIG_SENSORS=y
CONFIG_SENSORS_BMI055=y
CONFIG_SENSORS_CM3323=y
CONFIG_SENSORS_AK8963C=y
CONFIG_SENSORS_SX9500=y

#
# NFC features (NXP)
#
# CONFIG_PN547_NFC is not set
#
# Camera 8M sensor
#
# CONFIG_IMX135 is not set
CONFIG_IMX134=y

#
# LED configuration
#
CONFIG_LEDS_QPNP=y

#
# eDP ESD FUNCTION
#
CONFIG_EDP_ESD_FUNCTION=y
CONFIG_EDP_TCON_MDNIE=y
```

## arch/arm/configs/msm8974_sec_meliuscaktt_rev03_defconfig
```kconfig
CONFIG_SEC_LOCALE_KOR=y
CONFIG_SEC_OPERATOR_KTT=y
CONFIG_MACH_MELIUSCAKTT=y
CONFIG_LCD_CLASS_DEVICE=y
CONFIG_BACKLIGHT_LCD_SUPPORT=y
CONFIG_BACKLIGHT_CLASS_DEVICE=y
CONFIG_MDNIE_LITE_TUNING=y
CONFIG_LEDS_AN30259A=y
#
# ODE and DIR Encryption
#
CONFIG_CRYPTO=y
CONFIG_CRYPTO_SHA1=y
CONFIG_CRYPTO_SHA256=y
CONFIG_CRYPTO_AES=y
CONFIG_CRYPTO_CBC=y
CONFIG_ECRYPT_FS=y
CONFIG_WTL_ENCRYPTION_FILTER=y
CONFIG_KEYS=y
CONFIG_KEYS_DEBUG_PROC_KEYS=y
CONFIG_TDMB=y
CONFIG_TDMB_VENDOR_FCI=y
CONFIG_TDMB_FC8050=y
CONFIG_TDMB_SPI=y
CONFIG_TDMB_ANT_DET=y

CONFIG_TCP_CONG_ADVANCED=y
CONFIG_TCP_CONG_BIC=y
CONFIG_DEFAULT_BIC=y
CONFIG_DEFAULT_TCP_CONG="bic"

# TSP and TOUCHKEY
CONFIG_TOUCHSCREEN_SYNAPTICS_I2C_RMI=y

# BT
CONFIG_BT_BCM4339=y

# LCD mDNIe Chip 
CONFIG_SAMSUNG_CMC624=y
CONFIG_FB_MSM_MIPI_NOVATEK_VIDEO_HD_PT_PANEL=y

#
# Remove Qualcomm Wifi features
#
CONFIG_MSM_PIL_PRONTO=n
CONFIG_WCNSS_CORE=n
CONFIG_WCNSS_CORE_PRONTO=n
#
# Wifi features (Broadcomm)
#
CONFIG_NET_CORE=y
CONFIG_WIRELESS=y
CONFIG_WIRELESS_EXT_SYSFS=y
CONFIG_WEXT_CORE=y
CONFIG_WEXT_PROC=y
CONFIG_CFG80211=y
CONFIG_CFG80211_DEFAULT_PS=y
CONFIG_CFG80211_ALLOW_RECONNECT=y
CONFIG_WLAN=y
CONFIG_WIFI_CONTROL_FUNC=y
CONFIG_BCM4335=m
CONFIG_BROADCOM_WIFI_RESERVED_MEM=y
CONFIG_WLAN_REGION_CODE=202
CONFIG_MMC_MSM_SDC2_SUPPORT=y
#
# MAX77803 Charger
#
CONFIG_BATTERY_SAMSUNG=y
CONFIG_SAMSUNG_LPM_MODE=y
CONFIG_FUELGAUGE_MAX17048=y
CONFIG_CHARGER_MAX77803=y
CONFIG_SENSORS_HALL=y
#
# MAX77803 IC
#
CONFIG_MFD_MAX77803=y
CONFIG_REGULATOR_MAX77803=y
CONFIG_MOTOR_DRV_MAX77803=y
CONFIG_VIBETONZ=y
CONFIG_TOUCHSENSE_VIBRATOR=y
CONFIG_LEDS_MAX77803=y
CONFIG_USB_PRINTER=y
CONFIG_USB_STORAGE_DETECT=y
CONFIG_USB_HOST_NOTIFY=y
CONFIG_USB=y
#
# DWC3 usb 3.0 driver
#
CONFIG_USB_XHCI_HCD=y
CONFIG_USB_DWC3=y
CONFIG_USB_DWC3_MSM=y
#
# Actuator
#
CONFIG_I2C_ACTUATOR=y
#
# Sensor hub
#
CONFIG_SENSORS_SSP_ATMEL=y
CONFIG_SENSORS_SSP_CM3320=y
CONFIG_SENSORS_SSP_MAX88920=y
CONFIG_BCM2079X_NFC_I2C=y

# DHA Solution
CONFIG_SEC_DHA_SOL_MAL=y
# Ringback tone gain devide
CONFIG_SEC_DEVIDE_RINGTONE_GAIN=y
# Audience
CONFIG_SND_SOC_ES325=y
CONFIG_SND_SOC_ES325_SLIM=y
CONFIG_FW_LOADER=y
CONFIG_FIRMWARE_IN_KERNEL=y
CONFIG_EXTRA_FIRMWARE="audience-es325-fw-kor.bin"
CONFIG_EXTRA_FIRMWARE_DIR="firmware"
#
# NANDSWAP
#
CONFIG_FRONTSWAP=y
CONFIG_ZSMALLOC_NEW=y
CONFIG_PGTABLE_MAPPING=y
CONFIG_ZSWAP=y
CONFIG_DIRECT_RECLAIM_FILE_PAGES_ONLY=y
CONFIG_DIRECT_RECLAIM_ALLOW_COMPACTION=y
CONFIG_TIGHT_PGDAT_BALANCE=y
CONFIG_COMPACTION=y
CONFIG_VNSWAP=y

CONFIG_SEC_DEBUG_LMK_MEMINFO_VERBOSE=y
CONFIG_SEC_OOM_KILLER=y
CONFIG_SEC_DEBUG_LIST_PANIC=y
```

## arch/arm/configs/msm8974_sec_montblanc3g_ctc_defconfig
```kconfig
CONFIG_SEC_LOCALE_CHINA=y
CONFIG_SEC_OPERATOR_CTC=y
# CONFIG_MACH_H3GDUOS=y
CONFIG_MACH_MONTBLANC=y
CONFIG_LCD_CLASS_DEVICE=y
CONFIG_BACKLIGHT_LCD_SUPPORT=y
CONFIG_BACKLIGHT_CLASS_DEVICE=y
CONFIG_MDNIE_LITE_TUNING=y
CONFIG_FB_MSM_MIPI_SAMSUNG_OCTA_VIDEO_WVGA_S6E88A0_PT_PANEL=y
CONFIG_DUAL_LCD=y

#
# ODE and DIR Encryption
#
CONFIG_CRYPTO=y
CONFIG_CRYPTO_SHA1=y
CONFIG_CRYPTO_SHA256=y
CONFIG_CRYPTO_AES=y
CONFIG_CRYPTO_CBC=y
CONFIG_ECRYPT_FS=y
CONFIG_WTL_ENCRYPTION_FILTER=y
CONFIG_KEYS=y
CONFIG_KEYS_DEBUG_PROC_KEYS=y

# INPUT Devices
# CONFIG_TOUCHSCREEN_SYNAPTICS_I2C_RMI is not set
# CONFIG_KEYBOARD_CYPRESS_TOUCH is not set
# CONFIG_INPUT_WACOM is not set
CONFIG_TOUCHSCREEN_ATMEL_MXT224S_KS02=y
CONFIG_KEYBOARD_MELFAS_TOUCHKEY=y

# key
CONFIG_KEYBOARD_MATRIX=y
CONFIG_KEYBOARD_PMIC8XXX=n
CONFIG_SENSORS_HALL=n
CONFIG_INPUT_FLIP=y

# BT
CONFIG_BT_BCM4339=y

#
# MAX77803 Charger
#

# CONFIG_QPNP_CHARGER is not set
# CONFIG_QPNP_BMS is not set
CONFIG_BATTERY_SAMSUNG=y
CONFIG_SAMSUNG_LPM_MODE=y
CONFIG_FUELGAUGE_MAX17048=y
CONFIG_CHARGER_MAX77803=y

# CONFIG_GLOVE_TOUCH is not set
CONFIG_MMC_MSM_SDC3_SUPPORT=y

#
# Finger print sensor
#
#CONFIG_SENSORS_FINGERPRINT is not set
#CONFIG_SENSORS_VFS61XX is not set
#
# MAX77803 IC
#
CONFIG_MFD_MAX77803=y
CONFIG_REGULATOR_MAX77803=y
#CONFIG_MOTOR_DRV_MAX77803 is not set
#CONFIG_VIBETONZ is not set
CONFIG_MSM_VIBRATOR=y
CONFIG_LEDS_MAX77803=y
CONFIG_MUIC_DET_JACK=y
#
# Actuator
#
CONFIG_I2C_ACTUATOR=y
#
# Sensor hub
#
CONFIG_SENSORS_SSP_STM_MONTBLANC=y
CONFIG_SENSORS_SSP_MAX88921=y
CONFIG_SENSORS_SSP_SHTC1=n
# CONFIG_BCM2079X_NFC_I2C=y

# Earjack
# CONFIG_SAMSUNG_JACK is not set
CONFIG_INPUT_GPIO=y

#
# Remove Qualcomm Wifi features
#
CONFIG_MSM_PIL_PRONTO=n
CONFIG_WCNSS_CORE=n
CONFIG_WCNSS_CORE_PRONTO=n
#
# Wifi features (Broadcomm)
#
CONFIG_NET_CORE=y
CONFIG_WIRELESS=y
CONFIG_WIRELESS_EXT_SYSFS=y
CONFIG_WEXT_CORE=y
CONFIG_WEXT_PROC=y
CONFIG_CFG80211=y
CONFIG_CFG80211_DEFAULT_PS=y
CONFIG_CFG80211_ALLOW_RECONNECT=y
CONFIG_WLAN=y
CONFIG_WIFI_CONTROL_FUNC=y
CONFIG_BCM4339=y
CONFIG_BCMDHD_FW_PATH="/system/etc/wifi/bcmdhd_sta.bin"
CONFIG_BCMDHD_NVRAM_PATH="/system/etc/wifi/nvram_net.txt"
CONFIG_BROADCOM_WIFI_RESERVED_MEM=y
CONFIG_WLAN_REGION_CODE=300
CONFIG_TARGET_LOCALE_CHN=y
CONFIG_MMC_MSM_SDC2_SUPPORT=y
CONFIG_H_EUR_WIFI=y

#configs for ppp
CONFIG_PPP_FILTER=y
CONFIG_PPP_ASYNC=y
CONFIG_PPP_SYNC_TTY=y

#
# USB OTG
#
CONFIG_USB_STORAGE_DETECT=y

#
# DWC3 usb 3.0 driver
#
CONFIG_USB_XHCI_HCD=y
CONFIG_USB_DWC3=y
CONFIG_USB_DWC3_MSM=y

# DHA Solution
CONFIG_SEC_DHA_SOL_MAL=y
# Audience
CONFIG_SND_SOC_ES325=y
CONFIG_SND_SOC_ES325_SLIM=y
CONFIG_FW_LOADER=y
CONFIG_FIRMWARE_IN_KERNEL=y
CONFIG_EXTRA_FIRMWARE="audience-es325-fw-montblanc-chn-ctc.bin"
CONFIG_EXTRA_FIRMWARE_DIR="firmware"

## CHINA
#configs for modem interface
CONFIG_SEC_MODEM=y
CONFIG_GSM_MODEM_SPRD6500=y
CONFIG_GSM_MODEM_GG_DUOS=y
CONFIG_SEC_DUAL_MODEM_MODE=y
CONFIG_LINK_DEVICE_SPI=y
CONFIG_WORKQUEUE_FRONT=y
CONFIG_SWITCH_DUAL_MODEM=y
CONFIG_SIM_SLOT_SWITCH=y


# Audio
CONFIG_PCM_ROUTE_VOICE_STUB=y
# CONFIG_SND_SOC_MSM_HDMI_CODEC_RX is not set

# CONFIG_LEDS_AN30259A is not set

# LP8720
CONFIG_REGULATOR_LP8720=y

# SAPA
CONFIG_RTC_AUTO_PWRON=y
CONFIG_RTC_AUTO_PWRON_PARAM=y

#DUN
CONFIG_USB_DUN_SUPPORT=y
```

## arch/arm/configs/msm8974_sec_viennaeur_defconfig
```kconfig
CONFIG_SEC_LOCALE_EUR=y
CONFIG_SEC_OPERATOR_OPEN=y
CONFIG_MACH_VIENNAEUR=y
CONFIG_LCD_CLASS_DEVICE=y
CONFIG_BACKLIGHT_LCD_SUPPORT=y
CONFIG_BACKLIGHT_CLASS_DEVICE=y
CONFIG_FB_MSM_EDP_SAMSUNG=y
CONFIG_MOTOR_DRV_ISA1400=y
#
# ODE and DIR Encryption
#
CONFIG_CRYPTO=y
CONFIG_CRYPTO_SHA1=y
CONFIG_CRYPTO_SHA256=y
CONFIG_CRYPTO_AES=y
CONFIG_CRYPTO_CBC=y
CONFIG_ECRYPT_FS=y
CONFIG_WTL_ENCRYPTION_FILTER=y
CONFIG_KEYS=y
CONFIG_KEYS_DEBUG_PROC_KEYS=y

# BT
CONFIG_BT_BCM4339=y

#
# Battery driver(Charger, Fuelgauge)
#

# CONFIG_QPNP_CHARGER is not set
# CONFIG_QPNP_BMS is not set
CONFIG_BATTERY_SAMSUNG=y
CONFIG_SAMSUNG_LPM_MODE=y
CONFIG_FUELGAUGE_MAX17050=y
CONFIG_FUELGAUGE_MAX17050_COULOMB_COUNTING=y
CONFIG_CHARGER_BQ24260=y

CONFIG_SENSORS_HALL=y
CONFIG_GLOVE_TOUCH=y
CONFIG_MMC_MSM_SDC3_SUPPORT=y

#
# Finger print sensor
#
# CONFIG_SENSORS_FINGERPRINT is not set
# CONFIG_SENSORS_VFS61XX is not set
# CONFIG_SENSORS_VFS61XX_KO is not set

#
# Actuator
#
CONFIG_I2C_ACTUATOR=y

CONFIG_INPUT_WACOM=y

# Earjack
CONFIG_SAMSUNG_JACK=y
CONFIG_INPUT_GPIO=y

#
# Remove Qualcomm Wifi features
#
CONFIG_MSM_PIL_PRONTO=n
CONFIG_WCNSS_CORE=n
CONFIG_WCNSS_CORE_PRONTO=n
#
# Wifi features (Broadcomm)
#
CONFIG_NET_CORE=y
CONFIG_WIRELESS=y
CONFIG_WIRELESS_EXT_SYSFS=y
CONFIG_WEXT_CORE=y
CONFIG_WEXT_PROC=y
CONFIG_CFG80211=y
CONFIG_CFG80211_DEFAULT_PS=y
CONFIG_CFG80211_ALLOW_RECONNECT=y
CONFIG_WLAN=y
CONFIG_WIFI_CONTROL_FUNC=y
CONFIG_BCM4339=y
CONFIG_BCMDHD_FW_PATH="/system/etc/wifi/bcmdhd_sta.bin"
CONFIG_BCMDHD_NVRAM_PATH="/system/etc/wifi/nvram_net.txt"
CONFIG_BROADCOM_WIFI_RESERVED_MEM=y
CONFIG_WLAN_REGION_CODE=100
CONFIG_MMC_MSM_SDC2_SUPPORT=y
CONFIG_H_EUR_WIFI=y

#
# DWC3 usb 3.0 driver
#
CONFIG_USB_XHCI_HCD=y
CONFIG_USB_DWC3=y
CONFIG_USB_DWC3_MSM=y

# DHA Solution
CONFIG_SEC_DHA_SOL_MAL=y
# TouchScreen / TouchKey
CONFIG_TOUCHSCREEN_ATMEL_MXT1664S=y
CONFIG_USB_SWITCH_FSA9485=y

# Sensors
CONFIG_SENSORS=y
CONFIG_SENSORS_BMI055=y
CONFIG_SENSORS_CM3323=y
CONFIG_SENSORS_AK8963C=y
CONFIG_SENSORS_SX9500=y

#
# NFC features (NXP)
#
# CONFIG_NFC_PN547 is not set

#
# Camera 8M sensor
#
# CONFIG_IMX135 is not set
CONFIG_IMX134=y

#
# LED configuration
#
CONFIG_LEDS_QPNP=y

#
# eDP ESD FUNCTION
#
CONFIG_EDP_ESD_FUNCTION=y
CONFIG_EDP_TCON_MDNIE=y
```

## drivers/input/touchscreen/synaptics/Kconfig
```kconfig
#
# SYNAPTICS TOUCH driver configuration
#
config TOUCHSCREEN_SYNAPTICS_I2C_RMI_H
	tristate "Synaptics i2c touchscreen"
	depends on I2C
	help
	  This enables support for Synaptics RMI over I2C based touchscreens.
	  use Synaptics S5000 and S5050 IC.
```

## drivers/media/isdbt/Kconfig
```kconfig
config ISDBT
	bool "isdbt"

choice
	depends on ISDBT
	prompt "isdbt one-seg driver"
	default ISDBT_FC8150

	config ISDBT_FC8150
		bool "ISDBT_FC8150"
endchoice

config ISDBT_SPMI
	bool "isdbt spmi"
	default n

config ISDBT_ANT_DET
	bool "isdbt antenna detection"
	default n
```

## drivers/video/msm/mdss/Kconfig
```kconfig
config FB_MSM_MDSS_WRITEBACK
	bool "MDSS Writeback Panel"
	---help---
	The MDSS Writeback Panel provides support for routing the output of
	MDSS frame buffer driver and MDP processing to memory.

config FB_MSM_MDSS_HDMI_PANEL
	depends on FB_MSM_MDSS
	bool "MDSS HDMI Tx Panel"
	default n
	---help---
	The MDSS HDMI Panel provides support for transmitting TMDS signals of
	MDSS frame buffer data to connected hdmi compliant TVs, monitors etc.

config FB_MSM_MDSS_HDMI_MHL_SII8334
	depends on FB_MSM_MDSS_HDMI_PANEL
	bool 'MHL SII8334 support '
	default n
	---help---
	  Support the HDMI to MHL conversion.
	  MHL (Mobile High-Definition Link) technology
	  uses USB connector to output HDMI content

config FB_MSM_MDSS_DBG_SEQ_TICK
	bool "SEQ tick dbg support"
	default n

config FB_MSM_MDSS_DSI_DBG
	bool "DSI dbg support"
	default n	

config SAMSUNG_CMC624
	bool "Support for integrated LCD controller in msm89XX"
	depends on FB && ARCH_MSM
	default n

config FB_EBOOK_PANEL_SCENARIO
	bool "Samsung EBOOK PANEL SCENARIO"
	depends on FB_MSM
	depends on SAMSUNG_CMC624
	default n

config FB_MSM_MIPI_DSI_NOVATEK_NT35596
	bool
	select FB_MSM_MIPI_DSI
	default n
	
config FB_MSM_MIPI_NOVATEK_VIDEO_HD_PT
	bool
	select FB_MSM_MIPI_DSI_NOVATEK_NT35596
	default n

config FB_MSM_MIPI_NOVATEK_VIDEO_HD_PT_PANEL
	bool "MIPI NOVATEK VIDEO HD PT Panel"
	select FB_MSM_MIPI_NOVATEK_VIDEO_HD_PT
	default n
	
config MDNIE_LITE_TUNING
	bool "MDNIe lite panel tuning"
	default n

config FB_MSM_MIPI_SAMSUNG_OCTA_VIDEO_FULL_HD_PT_PANEL
	bool "Support SAMSUNG OCTA Video Full-HD Panel"
	default n

config FB_MSM_MIPI_SAMSUNG_OCTA_CMD_FULL_HD_PT_PANEL
	bool "Support SAMSUNG OCTA Command Full-HD Panel"
	default n

config FB_MSM_MIPI_SAMSUNG_YOUM_CMD_FULL_HD_PT_PANEL
	bool "Support SAMSUNG YOUM Command Full-HD Panel"
	default n

config MIPI_LCD_S6E3FA0_FORCE_VIDEO_MODE
	bool "Enforce DSI VIDEO Mode on S6E3FA0 panel"
	default n

config FB_MSM_MIPI_SAMSUNG_OCTA_VIDEO_WVGA_S6E88A0_PT_PANEL
	bool "Support SAMSUNG OCTA Video WVGA Panel"
	default n

config REGULATOR_LP8720
	bool "Support Regulator LP8720"
	default n

config DUAL_LCD
	bool "Support DUAL LCD"
	default n

config FB_MSM_MIPI_JDI_TFT_VIDEO_FULL_HD_PT_PANEL
	bool "Support JDI TFT VIDEO FULL HD Panel"
	select FB_MSM_MIPI_DSI
	default n

config SUPPORT_DISPLAY_OCTA_TFT
	bool "support OCTA and TFT panel"
	default n

config FB_MSM_CAMERA_CSC
	default n
	bool "Support SAMSUNG CAMERA CSC"
	---help---
		Support for camera CSC tuning

config FB_MSM_EDP_SAMSUNG
	bool "Support SAMSUNG EDP TCON"
	default n

config EDP_ESD_FUNCTION
	bool "Support EDP esd function"
	default n

config EDP_TCON_MDNIE
	bool "Support EDP mdnie function"
	default n

config FB_MSM_MIPI_TFT_VIDEO_FULL_HD_PT_PANEL
	bool "Support TFT VIDEO FULL HD Panel"
	select FB_MSM_MIPI_DSI
	default n

config ESD_ERR_FG_RECOVERY
	bool "ESD Feature"
	default n
```
