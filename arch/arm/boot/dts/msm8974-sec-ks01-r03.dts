/* Copyright (c) 2012-2013, The Linux Foundation. All rights reserved.
 *
 * This program is free software; you can redistribute it and/or modify
 * it under the terms of the GNU General Public License version 2 and
 * only version 2 as published by the Free Software Foundation.
 *
 * This program is distributed in the hope that it will be useful,
 * but WITHOUT ANY WARRANTY; without even the implied warranty of
 * MERCHANTABILITY or FITNESS FOR A PARTICULAR PURPOSE.  See the
 * GNU General Public License for more details.
 */

/dts-v1/;

/include/ "msm8974-v1-sec.dtsi"
/include/ "msm8974-sec-ks01-r03.dtsi"

/ {
	model = "Samsung KS01 rev0.3";
	compatible = "qcom,msm8974-cdp", "qcom,msm8974";
	/* qcom,msm-id = <126 1 0>; */
	qcom,msm-id = <0x7E015201 3 0>;
	/* [31:24] chip-id, [23:16] platform-id, [15:8] national code, [7:0] operator
		revision, reserved */

	qcom,mdss_dsi_samsung_octa_1080p_video {
		qcom,cont-splash-enabled;
	};
};

&ehci {
	status = "ok";
	vbus-supply = <&usb2_otg_sw>;
};
&usb3 {
	interrupt-names = "irq", "otg_irq", "hs_phy_irq", "pmic_id_irq";
        interrupt-parent = <&usb3>;
        interrupts = <0 1>;
        #interrupt-cells = <1>;
        interrupt-map-mask = <0x0 0xffffffff>;
        interrupt-map = <0x0 0 &intc 0 133 0
                         0x0 1 &spmi_bus 0x0 0x0 0x9 0x0>;
        interrupt-names = "hs_phy_irq", "pmic_id_irq";
        qcom,misc-ref = <&pm8941_misc>;
	qcom,dwc-hsphy-init = <0x00D192E4>;
};
