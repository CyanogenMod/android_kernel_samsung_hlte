/* Copyright (c) 2012, Samsung Electronics Corporation. All rights reserved.
 *
 * This program is free software; you can redistribute it and/or modify
 * it under the terms of the GNU General Public License version 2 and
 * only version 2 as published by the Free Software Foundation.
 *
 * This program is distributed in the hope that it will be useful,
 * but WITHOUT ANY WARRANTY; without even the implied warranty of
 * MERCHANTABILITY or FITNESS FOR A PARTICULAR PURPOSE.  See the
 * GNU General Public License for more details.
 */

/ {

	qcom,mdss_dsi_jdi_tft_fhd_video {
		compatible = "jdi,mdss-tft-dsi-panel";
		label = "JDI_ACX454AKM";
		status = "disable";
		qcom,dsi-ctrl-phandle = <&mdss_dsi0>;
		qcom,rst-gpio = <&pm8941_gpios 19 0>;
		qcom,bl-en-gpio = <&pm8941_gpios 26 1>;
		qcom,lcd-en-gpio = <&msmgpio 120 0>;
		qcom,mdss-pan-res = <1080 1920>;
		qcom,mdss-pan-bpp = <24>;
		qcom,mdss-pan-dest = "display_1";
		qcom,mdss-clk-rate=<906000000>;
		qcom,mdss-pan-porch-values = <100 14 97 6 2 8>; /* <HBP> <HPW> <HFP> <VBP> <VPW> <VFP> */
		qcom,mdss-pan-underflow-clr = <0x00>;
		qcom,mdss-pan-bl-ctrl = "bl_ctrl_dcs_cmds";
		qcom,mdss-pan-bl-levels = <1 255>;
		qcom,mdss-pan-dsi-mode = <0>;
		qcom,mdss-pan-dsi-h-pulse-mode = <0>;
		qcom,mdss-pan-dsi-h-power-stop = <0 0 0>;
		qcom,mdss-pan-dsi-bllp-power-stop = <1 1>;
		qcom,mdss-pan-dsi-traffic-mode = <2>;
		qcom,mdss-pan-dsi-dst-format = <3>;
		qcom,mdss-pan-dsi-vc = <0>;
		qcom,mdss-pan-dsi-rgb-swap = <0>;
		qcom,mdss-force-clk-lane-hs = <1>;
		samsung,mdss-early-lcd-on = <1>;
		qcom,mdss-pan-dsi-data-lanes = <1 1 1 1>;
		qcom,mdss-pan-dsi-dlane-swap = <0>;
		qcom,mdss-pan-dsi-t-clk = <0x1c 0x04>;
		qcom,mdss-pan-dsi-stream = <0>;
		qcom,mdss-pan-dsi-mdp-tr = <0x0>;
		qcom,mdss-pan-dsi-dma-tr = <0x04>;
		qcom,mdss-pan-dsi-frame-rate = <60>;
		qcom,panel-phy-regulatorSettings = [07 09 03 00  /* Regualotor settings */
						    20 00 01];
		qcom,panel-phy-timingSettings = [E6 49 27 00 69 72
							2B 4C 41 03 04 A0];
		qcom,panel-phy-strengthCtrl = [ff 06];		/*!!!! */
		qcom,panel-phy-bistCtrl = [00 00 b1 ff           /*!!!! BIST Ctrl settings */
					   00 00];
		qcom,panel-phy-laneConfig = [
		00 00 00 00 00 00 00 01 97 /* lane0 config */
		00 00 00 00 05 00 00 01 97 /* lane1 config */
		00 00 00 00 0a 00 00 01 97 /* lane2 config */
		00 00 00 00 0f 00 00 01 97 /* lane3 config */
		00 c0 00 00 00 00 00 01 bb]; /* Clk ln config */

		qcom,panel-on-cmds = [
					39 01 00 00 00 00 02 51 B6 /* Brightness setting */
					39 01 00 00 00 00 02 55 00 /* CABC control */
					39 01 00 00 00 00 02 53 2C /* Brightness control */
					39 01 00 00 00 00 02 35 01 /* HSYNC On*/
					39 01 00 00 78 00 02 11 00 /* Sleep out */
					39 01 00 00 28 00 02 29 00 /* Display on */
					];
		qcom,on-cmds-dsi-state = "DSI_LP_MODE";
		qcom,panel-off-cmds = [
					39 01 00 00 28 00 02 28 00 /* Display off */
					39 01 00 00 78 00 02 10 00 /* Sleep in */
					];
		qcom,off-cmds-dsi-state = "DSI_HS_MODE";

		qcom,panel-display-on-cmds = [05 01 00 00 32 00 02 29 00];
		qcom,panel-display-off-cmds = [05 01 00 00 32 00 02 28 00];

		qcom,panel-display-unblank-cmds = [05 01 00 00 32 00 02 13 00];			/*Normal mode command*/
		qcom,panel-display-blank-cmds = [05 01 00 00 45 00 02 22 00];		 /* All pixel off - for making display black*/

		samsung,panel-late-on-cmds = [ 29 01 00 00 05 00 02 29 00 ]; /* Late on */
		samsung,panel-early-off-cmds = [ 29 01 00 00 00 00 02 28 00 ]; /* Early off */
		samsung,panel-brightness-cmds = [ 39 01 00 00 00 00 02 51 B6 ]; /* brightness packet */
		samsung,panel-mtp-enable-cmds = [
							29 01 00 00 00 00 02 b0 04
							29 01 00 00 00 00 04 00 00 00 00
							29 01 00 00 00 00 04 00 00 00 00
							];
		samsung,panel-mtp-disable-cmds = [ 29 01 00 00 00 00 02 b0 03 ];
		samsung,panel-cabc-on-cmds = [
							29 01 00 00 00 00 02 CE 00
							29 01 00 00 00 00 02 55 01
							];
		samsung,panel-cabc-off-cmds = [
							29 01 00 00 00 00 0F CE 80 19 19 19 19 19 19 19 19 19 19 19 19 19
							29 01 00 00 00 00 02 55 00
							];
		samsung,panel-hsync-on-cmds = [ 39 01 00 00 00 00 02 35 01 ];
		samsung,panel-hsync-off-cmds = [ 39 01 00 00 00 00 02 35 00 ];

			/* the last byte in all read commands will represent READ LENGH */
			samsung,panel-manufacture-id-read-cmds = [
								06 01 00 00 00 00 01 da 01 00
								06 01 00 00 00 00 01 db 01 00
								06 01 00 00 00 00 01 dc 01 00];

		/*
		 * ************************************************************************************************************************
		 * candela to index mappings
		 * ************************************************************************************************************************
		 */
		samsung,panel-candela-mapping-table = <
			/*<idx>		<from>		<till>		<candella>	<tft-pwm> */
			0		0		10		10		3
			1		11		11		11		4
			2		12		12		12		5
			3		13		13		13		5
			4		14		14		14		6
			5		15		15		15		7
			6		16		16		16		8
			7		17		18		17		9
			8		19		19		19		9
			9		20		20		20		10
			10		21		21		21		11
			11		22		23		22		11
			12		24		24		24		12
			13		25		26		25		13
			14		27		28		27		14
			15		29		29		29		15
			16		30		31		30		16
			17		32		32		32		17
			18		33		36		34		19
			19		37		38		37		20
			20		39		40		39		21
			21		41		43		41		22
			22		44		46		44		24
			23		47		49		47		26
			24		50		52		50		28
			25		53		55		53		29
			26		56		59		56		31
			27		60		63		60		34
			28		64		67		64		37
			29		68		71		68		39
			30		72		76		72		41
			31		77		81		77		44
			32		82		86		82		47
			33		87		92		87		50
			34		93		97		93		53
			35		98		104		98		57
			36		105		110		105		61
			37		111		118		111		64
			38		119		125		119		69
			39		126		133		126		71
			40		134		142		134		74
			41		143		149		143		78
			42		150		161		152		82
			43		162		171		162		92
			44		172		182		172		102
			45		183		194		183		114
			46		195		206		195		126
			47		207		219		207		137
			48		220		232		220		151
			49		233		248		234		166
			50		249		249		249		177
			51		250		251		265		178
			52		252		253		282		179
			53		254		255		300		182
			>;

		/* Lux table mapping for Smart dimming*/
		samsung,panel-smart-dimming-lux-table = <
			10  11  12  13  14
			15  16  17  19  20
			21  22  24  25  27
			29  30  32  34  37
			39  41  44  47  50
			53  56  60  64  68
			72  77  82  87  93
			98  105 111 119 126
			134 143 152 162 172
			183 195 207 220 234
			249 265 282 300>;
	};
};
